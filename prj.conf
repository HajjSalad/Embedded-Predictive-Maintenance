## CMakeLists.txt
```
# SPDX-License-Identifier: Apache-2.0


# Specify the minimum required CMake version
cmake_minimum_required(VERSION 3.20.0)

# Locate the Zephyr build system using the ZEPHYR_BASE environment variable
find_package(Zephyr REQUIRED HINTS $ENV{ZEPHYR_BASE})

# Define the project name
project(edge_pm)

# Specify the application source files (PRIVATE: means sources only used by this target)
# Apparently GLOB CMake won't automatically re-run if you add a new file, you have to manually re-run cmake once
target_sources(app PRIVATE 
    src/main.c 
    src/utils/demo.cpp 
    src/machines/sensor.cpp 
    src/machines/wrapper.cpp 
    src/threads/thread_sensor_read.c 
    src/threads/thread_sensor_write.c 
    src/threads/thread_anomaly_detect.c 
    src/threads/thread_anomaly_handle.c 
    src/threads/thread_system_logger.c 
    src/core/detection.c
    src/core/circular_buffer.c)

# Include directories
target_include_directories(app PRIVATE include include/core include/machines include/threads include/utils)

# Enable C++ support 
set(Zephyr_EXTRA_MODULES app)
```

## prj.conf
```kconfig
# GPIO driver support
CONFIG_GPIO=y

# Enable printk()
CONFIG_PRINTK=y

# Newlib C standard library
CONFIG_NEWLIB_LIBC=y

# Enable C++ support
CONFIG_CPP=y

# Enable C++ standard library 
CONFIG_GLIBCXX_LIBCPP=y

# Hardware Floating Point Unit (FPU) support
CONFIG_FPU=y
```

## src/main.c
```c
/**
 * @file  main.c
 * @brief System entry point and initialization sequence.
 * 
 * This file is responsoble for:
 *  - Bringing up core system components 
 *  - Initializing the application modules
 *  - Spawning application threads after initialization
*/
#include <zephyr/kernel.h>

#include "shared_resources.h"
#include "demo.h"
#include "threads.h"
#include "wrapper.h"
#include "circular_buffer.h"

/** @brief Stack size in bytes allocated for each thread */
#define STACK_SIZE      2048U

/** @brief Thread priorities - In Zephyr, 0 is highest priority */
#define PRIORITY_3      3
#define PRIORITY_4      4
#define PRIORITY_5      5
#define PRIORITY_6      6
#define PRIORITY_7      7

/** @brief Instantiate the circular buffer */
CircularBuffer circular_buffer;  

/**
 * @brief Message queue for passing log messages from threads 1-4 to system_logger
 * 
 * Holds up to @ref LOG_QUEUE_SIZE messages of type @ref log_msg_t.
 * Defined here and declared extern in shared_resources.h.
*/
K_MSGQ_DEFINE(log_queue, sizeof(log_msg_t), LOG_QUEUE_SIZE, MESSAGE_ALIGN);

/* */
K_MUTEX_DEFINE(sensor_mutex);
K_MUTEX_DEFINE(buffer_mutex);

// /** @brief Thread stacks - statically allocated */
K_THREAD_STACK_DEFINE(sensor_write_stack,    STACK_SIZE);
K_THREAD_STACK_DEFINE(sensor_read_stack,     STACK_SIZE);
K_THREAD_STACK_DEFINE(anomaly_detect_stack,  STACK_SIZE);
K_THREAD_STACK_DEFINE(anomaly_handle_stack,  STACK_SIZE);
K_THREAD_STACK_DEFINE(system_log_stack,      STACK_SIZE);

// /** @brief Declare Thread control blocks (TCB holds: priority, stack pointers etc) */
struct k_thread sensor_write_thread;
struct k_thread sensor_read_thread;
struct k_thread anomaly_detect_thread;
struct k_thread anomaly_handle_thread;
struct k_thread system_log_thread;

/**
 * @brief Spawn all application threads.
 *
 * Called at the end of main() after all initialization is complete,
 * guaranteeing that machines, sensors, and the circular buffer are
 * ready before any thread begins execution.
*/
static void spawn_threads(void)
{
    /**
     * k_thread_create() creates and starts the thread: Initializes the TCB,
     * links it to the stack, and adds it to the scheduler's ready queue.
     */
    k_thread_create(&sensor_write_thread, sensor_write_stack,
                    K_THREAD_STACK_SIZEOF(sensor_write_stack),
                    (k_thread_entry_t)sensor_write,
                    NULL, NULL, NULL, PRIORITY_3, 0, K_NO_WAIT);
    //printk("sensor_write thread created\n");

    k_thread_create(&sensor_read_thread, sensor_read_stack,
                    K_THREAD_STACK_SIZEOF(sensor_read_stack),
                    (k_thread_entry_t)sensor_read,
                    NULL, NULL, NULL, PRIORITY_4, 0, K_NO_WAIT);
    //printk("sensor_read thread created\n");

    k_thread_create(&anomaly_detect_thread, anomaly_detect_stack,
                    K_THREAD_STACK_SIZEOF(anomaly_detect_stack),
                    (k_thread_entry_t)anomaly_detect,
                    NULL, NULL, NULL, PRIORITY_5, 0, K_NO_WAIT);
    //printk("anomaly_detect thread created\n");

    k_thread_create(&anomaly_handle_thread, anomaly_handle_stack,
                    K_THREAD_STACK_SIZEOF(anomaly_handle_stack),
                    (k_thread_entry_t)anomaly_handle,
                    NULL, NULL, NULL, PRIORITY_6, 0, K_NO_WAIT);
    //printk("anomaly_handle thread created\n");

    k_thread_create(&system_log_thread, system_log_stack,
                    K_THREAD_STACK_SIZEOF(system_log_stack),
                    (k_thread_entry_t)system_log,
                    NULL, NULL, NULL, PRIORITY_7, 0, K_NO_WAIT);
    //printk("system_log thread created\n");
}

/**
 * @brief Main system entry point.
 * 
 * Performs one-time system initialization:
 *  - Run C++ interopability demo
 *  - Creates machine instances and registers sensors
 *  - Initializes the circular buffer
 *  - Spawns application threads
 *
 * After initialization, the function idles while
 * background threads execute the application logic.
 *
 * @return Never returns
*/
int main(void) 
{
    printk("\n*** Program Start ***\n");                 

    // C++ interopability Demo                                     
    printk("Demo Message: %s\n", demo_get_message());

    // Create machines and register their sensors
    generate_machines_and_sensors();

    // Initialize the circular buffer
    circular_buffer_init(&circular_buffer);

    // Spawn threads after initialization is complete
    spawn_threads();

    //printk("Threads spawned\n");
    
    // Keep main alive - threads drive all application logic
    while (1) {
        k_sleep(K_FOREVER);
    }

    return 0;
}
```

## include/demo.h
```c
#ifndef DEMO_H
#define DEMO_H

/**
 * @file demo.h
 * @brief Header for the Demo C++ module exposed to C code.
*/

#ifdef __cplusplus
extern "C" {
#endif

// Function prototypes
const char* demo_get_message(void);

#ifdef __cplusplus
}
#endif

#endif // DEMO_H
```

## include/machines.h
```c
#ifndef MACHINES_H
#define MACHINES_H

#include "sensor_wrapper.h"

/**
 * @file machines.h
 * @brief Defines machine configuration and interface to generate machine instances.
*/

/** @brief Number of machines currently in the system */
#define NUM_MACHINES 3

/** @brief Array to hold machine handles */
extern MachineHandle machines[NUM_MACHINES];

// Function Prototype
void generate_machines_and_sensors(void);

/** Machine configuration for each machine type */
static const MachineConfig machine_configs[] = 
{
    {   "Air Compressor",
        {   {"Temperature", 60.0f, 100.0f},         // 60 - 100°C
            {"Pressure", 72.0f, 145.0f},            // 72 - 145 psi
            {"Vibration", 0.5f, 2.0f} },            // 0.5 - 2.0 mm/s
        3                                           // Number of sensors
    },
    {   "Steam Boiler",
        {   {"Temperature", 150.0f, 250.0f},        // 150 - 250°C
            {"Pressure", 87.0f, 360.0f},            // 87 - 360 psi
            {"", 0.0f, 0.0f} },                     // Leave these empty
        2                                           // Number of sensors
    },
    {   "Electric Motor",
        {   {"Temperature", 60.0f, 105.0f},         // 60 - 105°C
            {"", 0.0f, 0.0f},                       // Leave empty
            {"", 0.0f, 0.0f} },                     // Leave empty
        1                                           // Number of sensors
    }
};

#endif // MACHINES_H
```

## include/sensor.h
```c
#ifndef SENSOR_H
#define SENSOR_H

/**
 * @file sensor.h
 * @brief Sensor abstractions, concrete sensor types, and Machine model.
 * 
 * This file defines:
 *  - A polymorphic Sensor interface
 *  - Concrete sensor implementation (Temperature, Pressure, Vibration)
 *  - A SensorFactory for controlled sensor creation
 *  - A Machine class that aggregates sensors
*/

#include <memory>
#include <vector>
#include <string>
#include <stdint.h>

#include "sensor_wrapper.h"

/**
 * @class Sensor
 * @brief Abstract base class for all sensors
 * 
 * Defines the common interface that all sensor types must implement. This
 * allows machines to interact with sensors polymorphically without knowing
 * their concrete type.
 * 
 * Provides a protected data member `Value` so all derived sensors follow 
 * a consistent pattern for storing their latest reading.
 * 
 * The public methods are declared pure virtual, enforcing that every concrete 
 * sensor provides its own implementation and enabling runtime polymorphism 
 * when accessed via base-class pointers.
*/
class Sensor {
protected:
    float Value;        /**< Latest sensor reading */

public:
    /** 
    * @brief Set the sensor value.
    * @param value New sensor reading 
    */
    virtual void setValue(float value) = 0;

    /** 
    * @brief Read the current sensor value
    * @return Current sensor reading 
    */
    virtual float readValue() = 0;

    /**
    * @brief Get the sensor type as a string.
    * @return Sensor type identifier
    */
    virtual std::string getType() = 0;

    /** @brief Virtual deconstructor for safe polymorphic cleanup */
    virtual ~Sensor() {}
};

/**
 * @class TempSensor
 * @brief Concrete sensor representing a temperature sensor.
 * 
 * Inherits from the abstract base class 'Sensor' and implements all
 * its pure virtual methods. 
 * 
 * Stores the latest temperature reading in the inherited `Value` member.
 * 
 * This class can be used polymorphically through `Sensor*` or 
 * `std::unique_ptr<Sensor>` without knowing the concrete type.
*/
class TempSensor : public Sensor {
public:
    /**
    * @brief Set the temperature sensor reading
    * @param value The new temperature value to store
    */
    void setValue(float value) override;

    /**
    * @brief Read the current temperature value
    * @return The latest temperature reading
    */
    float readValue() override;

    /**
    * @brief Get the sensor type identifier
    * @return Returns the string "Temperature"
    */
    std::string getType() override;
};

/**
 * @class PressureSensor
 * @brief Concrete sensor representing a pressure sensor.
*/
class PressureSensor : public Sensor {
public:
    void setValue(float value) override;
    float readValue() override;

    /**
    * @brief Get the sensor type identifier
    * @return Returns the string "Pressure"
    */
    std::string getType() override;
};

/**
 * @class VibrationSensor
 * @brief Concrete sensor representing a pressure sensor.
*/
class VibrationSensor : public Sensor {
public:
    void setValue(float value) override;
    float readValue() override;

    /**
    * @brief Get the sensor type identifier
    * @return Returns the string "Vibration"
    */
    std::string getType() override;
};

/**
 * @class SensorFactory
 * @brief Factory class to create sensor objects dynamically.
 * 
 * Provides a centralized way to instantiate different types of sensors
 * based on a string identifier. This follows the Factory Method design pattern,
 * allowing the rest of the system to remain decoupled from concrete sensor types.
 */
class SensorFactory {
public:
    /**
     * @brief Create a sensor instance based on a type string.
     * 
     * @param type Type of sensor to create ("Temperature", "Pressure", "Vibration")
     * 
     * @return std::unique_ptr<Sensor> Pointer to the newly created created sensor object.
     *         Returns nullptr if the type is unknown. 
     */
    static std::unique_ptr<Sensor> createSensor(const std::string& type);
};

/**
 * @class Machine
 * @brief Represents a physical machine containing multiple sensors.
 * 
 * The Machine class stores:
 *  - The type of machine (`type`)
 *  - A unique name identifier (`name`)
 *  - A collection of sensors (`sensors`) managed via `std::unique_otr<Sensor>`
 * 
 * Sensors are stored polymorphically, so a machine can hold any type
 * derived from the abstract `Sensor` base class. The class provides
 * methods to interact with sensors without needing to know their concrete types.
*/
class Machine {
private:
    MachineType type;                               /**< Type of the machine */

public:
    std::string name;                               /**< Name of the machine */
    std::vector<std::unique_ptr<Sensor>> sensors;   /**< Polymorphic sensor list */

    /**
     * @brief Construct a Machine object with name, sensor types, and machine type.
     * 
     * Dynamically creates sensors using SensorFactory for each type provided.
     * 
     * @param machineName Name of the machine
     * @param sensorTypes List of sensor type strings ("Temperature", "Pressure", etc.)
     * @param machineType Enum representing the machine type
    */
    Machine(const std::string& machineName, const std::vector<std::string>& sensorTypes, MachineType machineType);
    
    /** @brief Display the machine name and all associated sensors */
    void display() const;

    /** @brief Set the value of a specific sensor by type */
    void setSensorValue(const std::string& type, float value);

    /** @brief Get the value of a specific sensor by type */
    float getSensorValue(const std::string& type);

    /** @brief Get the type of the machine */
    MachineType getType() const { return type; }
};

#endif // SENSOR_H
```

## include/sensor_wrapper.h
```c
#ifndef SENSOR_WRAPPER_H
#define SENSOR_WRAPPER_H

/**
 * @file sensor_wrapper.h
 * @brief C-compatible wrapper interface for Machine and Sensor system.
*/
#ifdef __cplusplus
extern "C" {
#endif

/**
 * @enum MachineType
 * @brief Enumeration of supported machine types.
 * 
 * Used to classify machines at creation time and determine their behavior
 * or sensor configuration
*/
typedef enum {
    AIR_COMPRESSOR,
    STEAM_BOILER,
    ELECTRIC_MOTOR
} MachineType;

/**
 * @struct SensorConfig 
 * @brief Configuration data for a single sensor.
 * 
 * Describes valid operating ranges for a sensor type.
*/
typedef struct {
    const char* name;     /**< Sensor name or type identifier */
    float min_value;      /**< Minimum valid sensor value */
    float max_value;      /**< Maximum valid sensor value */
} SensorConfig;

/**
 * @struct MachineConfig
 * @brief Configuration decribing a machine and its sensors.
 * 
 * Defines the sensors attached to a machine and how many are active.
*/
typedef struct {
    const char* name;                 /**< Machine name */
    SensorConfig sensors[3];          /**< List of attached sensors */
    int num_sensors;                  /**< Number of valid sensors */
} MachineConfig;

/**
 * @typedef MachineHandle
 * @brief Opaque handle to machine instance.
 * 
 * Represents an internal C++ Machine object without exposing its 
 * implementation details to C code.
*/
typedef void* MachineHandle;

// Function Prototypes
MachineHandle create_machine(const char* machine_name, MachineType type);
void destroy_machine(MachineHandle handle);
void describe_machine(MachineHandle handle);
void set_sensor_value(MachineHandle handle, const char* sensor_type, float value);
float get_sensor_value(MachineHandle handle, const char* sensor_type);
const char* get_machine_type_string(MachineType type);
MachineType get_machine_type(MachineHandle handle);

#ifdef __cplusplus
}
#endif

#endif // SENSOR_WRAPPER_H
```

## include/shared_resources.h
```c
#ifndef SHARED_RESOURCES_H
#define SHARED_RESOURCES_H

/**
 * @file shared_resources.h
 * @brief Shared data structures and definitions for inter-thread communication.
*/

#include <zephyr/kernel.h>

#define LOG_MSG_SIZE                128
#define LOG_QUEUE_SIZE              32

/** @brief Memory alignment for the message queue buffer in bytes */
#define MESSAGE_ALIGN               4

/** @brief Global message queue for serialized terminal logging  */
extern struct k_msgq log_queue;

extern struct k_mutex sensor_mutex;
extern struct k_mutex buffer_mutex;

/** 
 * @brief Log message structure for inter-thread communication
 * 
 * Passed through the logging message queue from threads 1-4
 * to the system logger (thread 5) for terminal output.
*/
typedef struct {
    int thread_id;                      /**< ID of the thread that emitted the message */
    char message[LOG_MSG_SIZE];         /**< Null-terminated log message string */
} log_msg_t;

/**
 * @brief Represents a single sensor reading from a machine.
 * 
 * Stores the machine and sensor identity alongside the recorded value
 * and its valid operating range. Used as the unit of data passed
 * through the circular buffer from Thread 2 to Thread 3.
*/
struct sensor_reading { 
    char machine_name[30];      /**< Name of the machine this reading belongs to */
    char sensor_type[16];       /**< Name of the sensor that produced the reading */
    float value;                /**< Recorded sensor value */
    float min_value;            /**< Minimum value of the sensor's valid operating range */
    float max_value;            /**< Maximum value of the sensor's valid operating range */
};

#endif // SHARED_RESOURCES_H
```

## include/threads.h
```c
#ifndef THREADS_H
#define THREADS_H

/**
 * @file threads.h
 * @brief 
*/

#include <zephyr/kernel.h>

/** @brief Size of each log message in bytes */
#define LOG_MSG_SIZE                64

/** @brief Max number of log messages in the queue */
#define LOG_QUEUE_SIZE              16

/** @brief Memory alignment for the message queue buffer in bytes */
#define MESSAGE_ALIGN               4

/** 
 * @brief Log message structure for inter-thread communication
 * 
 * Passed through the logging message queue from threads 1-4
 * to the system logger (thread 5) for terminal output.
*/
typedef struct {
    int thread_id;                      /**< ID of the thread that emitted the message */
    char message[LOG_MSG_SIZE];         /**< Null-terminated log message string */
} log_msg_t;

/** @brief Global message queue for serialized terminal logging  */
extern struct k_msgq log_queue;

// Function Prototypes
void sensor_data_writer(void);
void data_collector(void);
void anomaly_detector(void);
void anomaly_handler(void);
void system_logger(void);

#endif // THREADS_H
```

## src/demo.cpp
```c
/**
 * @file demo.cpp
 * @brief Simple C++ demo module exposed to C code.
 *
 * This file demonstartes how C++ functionality can be safely 
 * used in a Zephyr project and accessed from C code.
*/

#include "demo.h"
#include <string>

/**
 * @class Demo
 * @brief Internal C++ helper class.
 * 
 * This class is not exposed outside this file.
 * It encapsulates C++-only logic and returns a std::string
*/
class Demo {
public:
    /**
     * @brief Get a demo message.
     * @return std::string containing a demo message
     */
    std::string getMessage() {
        return "Hello from C++!";
    }
};

/** @brief Global instance of the Demo class */
static Demo demoInstance;

/**
 * @brief Get a demo message as a C-style string.
 * 
 * This function bridges C++ std::string with C code by 
 * returning a null-terminated string (const char*)
 * 
 * @note The returned pointer remains valid because the 
 * underlying std::string is declared static.
 * 
 * @return Pointer to a null-terminated string
 */
const char* demo_get_message(void) {
    static std::string message = demoInstance.getMessage();
    return message.c_str();
}
```

## src/machine.c
```c
#include "demo.h"
#include "sensor_wrapper.h"
#include "tflite_wrapper.h"
#include <time.h>
#include <stdio.h>
#include <stdlib.h>
#include <string.h>
#include <zephyr/kernel.h>
#include <zephyr/device.h>
#include <zephyr/sys/printk.h>
#include <zephyr/drivers/gpio.h>
#include <zephyr/sys/__assert.h>


#define NUM_MACHINES         3



MachineHandle machines[NUM_MACHINES];

static const MachineConfig machine_configs[] = 
{
    {   "Air Compressor",
        {   {"Temperature", 60.0f, 100.0f},         // 60 - 100°C
            {"Pressure", 72.0f, 145.0f},            // 72 - 145 psi
            {"Vibration", 0.5f, 2.0f} },            // 0.5 - 2.0 mm/s
        3
    },
    {   "Steam Boiler",
        {   {"Temperature", 150.0f, 250.0f},        // 150 - 250°C
            {"Pressure", 87.0f, 360.0f},            // 87 - 360 psi
            {"", 0.0f, 0.0f} },                     // Leave these empty
        2
    },
    {   "Electric Motor",
        {   {"Temperature", 60.0f, 105.0f},         // 60 - 105°C
            {"", 0.0f, 0.0f},                       // Leave empty
            {"", 0.0f, 0.0f} },                     // Leave empty
        1
    }
};

void generate_machines() 
{
    //   To create and add machine:
    //   1. Increment NUM_MACHINES
    //   2. Create machine instance   

    // Create a Machine instance with specified sensors
    machines[0] = create_machine("Air_Compressor_1", AIR_COMPRESSOR);
    machines[1] = create_machine("Steam_Boiler_1", STEAM_BOILER);
    machines[2] = create_machine("Electric_Motor_1", ELECTRIC_MOTOR);

    // Print Machine details - name, sensors
    for (int i=0; i<NUM_MACHINES; i++) {
        describe_machine(machines[i]);
    }
}
```

## src/machines.c
```c
/**
 * @file machines.c
 * @brief Machine creation and management.
 * 
 * This file implements functions to create and manage industrial machine
 * instances and their associated sensors.
*/

#include <stdio.h>

#include "machines.h"
#include "sensor_wrapper.h"

/** @brief Array to hold machine handles */
MachineHandle machines[NUM_MACHINES];

/**
 * @brief Generate machine instances and register their sensors
 * 
 * Uses the `create_machine` function from the C++ wrapper to create machines
 * for Air Compressor, Steam Boiler, and Electric Motor. 
 * 
 * Machine handles are stored in the global `machines` array. 
 * 
 * After creation, each machine is described via `describe_machine`.
*/
void generate_machines_and_sensors() 
{
    //   To create and add machine:
    //   1. Increment NUM_MACHINES
    //   2. Create machine instance   

    // Create a Machine instance with specified sensors
    machines[0] = create_machine("Air_Compressor_1", AIR_COMPRESSOR);
    machines[1] = create_machine("Steam_Boiler_1", STEAM_BOILER);
    machines[2] = create_machine("Electric_Motor_1", ELECTRIC_MOTOR);

    // Print Machine details: name and sensors
    for (int i=0; i<NUM_MACHINES; i++) {
        describe_machine(machines[i]);
    }
}

/**
 * @brief Cleanup all machine instances
 * 
 * Calls `destroy_machine` for each machine to free memory allocated in C++.
*/
void cleanup_machines(void)
{
    for (int i = 0; i < NUM_MACHINES; i++) {
        destroy_machine(machines[i]);
        machines[i] = NULL;
    }
}
```

## src/sensor.cpp
```c
/**
 * @file sensor.cpp
 * @brief Implementation of sensors, factory, and Machine logic.
 * 
 * Contains concrete sensor behavior and runtime composition of machines 
 * and their sensors.
*/

#include <memory>
#include <string>
#include <vector>
#include <stdio.h>
#include <iostream>

#include "sensor.h"
#include "sensor_wrapper.h"

// -----------------------------------------------------------------------------
// Concrete Sensor Implementations
// -----------------------------------------------------------------------------
void TempSensor::setValue(float value) { Value = value; }
float TempSensor::readValue() { return Value; }
std::string TempSensor::getType() { return "Temperature"; }

void PressureSensor::setValue(float value) { Value = value; }
float PressureSensor::readValue() { return Value; }
std::string PressureSensor::getType() { return "Pressure"; }

void VibrationSensor::setValue(float value) { Value = value; }
float VibrationSensor::readValue() { return Value; }
std::string VibrationSensor::getType() { return "Vibration"; }

// -----------------------------------------------------------------------------
// SensorFactory Implementation
// -----------------------------------------------------------------------------
/**
 * @brief Create a concrete sensor instance based on type identifier
 * 
 * Uses a simple string-based factory to construct the appropriate sensor
 * subclass at runtime.
 * 
 * @param type Sensor type identifier ("Temperature", "Pressure", "Vibration")
 * 
 * @return std::unique_ptr<Sensor> Owning pointer to the created sensor
 *         Return nullptr if the type is unsupported
*/
std::unique_ptr<Sensor> SensorFactory::createSensor(const std::string& type) 
{
    if (type == "Temperature") {
        return std::unique_ptr<Sensor>(new TempSensor());
    } else if (type == "Pressure") {
        return std::unique_ptr<Sensor>(new PressureSensor());
    } else if (type == "Vibration") {
        return std::unique_ptr<Sensor>(new VibrationSensor());
    }
    return nullptr;
}

// -----------------------------------------------------------------------------
// Machine Implementation
// -----------------------------------------------------------------------------
/**
 * @brief Construct a machine with a set of sensors
 * 
 * Sensors are created dynamically at runtime using the SensorFactory based on 
 * the provided sensor type list.
 * 
 * @param machineName Human-readable machine name
 * @param sensorTypes List of sensor type identifiers
 * @param machineType Machine classification
*/
Machine::Machine(const std::string& machineName, 
                 const std::vector<std::string>& sensorTypes, 
                 MachineType machineType) 
    : type(machineType), name(machineName)  
{
    for (const auto& type : sensorTypes) {
        auto sensor = SensorFactory::createSensor(type);
        if (sensor) {
            sensors.push_back(std::move(sensor));
        }
    }
}

/** @brief Display machine information and attached sensors */
void Machine::display() const {
    std::cout << "Machine: " << name << std::endl;
    for (const auto& sensor : sensors) {
        std::cout << "  - Sensor Type: " << sensor->getType() << std::endl;
    }
}

/**
 * @brief Set the value of a specific sensor by type
 * 
 * @param type Sensor type identifier
 * @param value Value to assign to the sensor
*/
void Machine::setSensorValue(const std::string& type, float value) {
    for (auto& sensor : sensors) {
        if (sensor->getType() == type) {
            sensor->setValue(value);
            return;
        }
    }
    std::cout << "Sensor type " << type 
              << " not found in machine " << name << std::endl;
}

/**
 * @brief Retrieve the current value of a specific sensor
 * 
 * @param type Sensor type identifier
 * @return Sensor value
 *         -1.0f if the sensor is not found
 */
float Machine::getSensorValue(const std::string& type) {
    for (const auto& sensor : sensors) {
        if (sensor->getType() == type) {
            return sensor->readValue();
        }
    }
    std::cout << "Sensor type " << type << " not found in machine " << name << std::endl;
    return -1.0f;
}
```

## src/sensor_wrapper.cpp
```c
/**
 * @file sensor_wrapper.cpp
 * @brief C-compatible warpper for C++ Machine and Sensor classes.
 * 
 * This file provides a C API that allows pure C code (including Zephyr
 * threads written in C) to interact with C++ Machine and Sensor objects.
 * 
 *  
*/

#include <vector>
#include <string>
#include <cstring>

#include "sensor.h"
#include "sensor_wrapper.h"

// --------------------------------------------------------------------------
// Sensor configuration per machine type
// -------------------------------------------------------------------------- 

/**
 * @brief Sensor set for an air compressor
 * 
 * Air compressors are monitored for: Temperature, Pressure and Vibration
*/
const std::vector<std::string> air_compressor_sensors = {
    "Temperature", "Pressure", "Vibration"
};

/**
 * @brief Sensor set for an Steam Boiler
 * 
 * Steam boilers are monitored for: Temperaature and Pressure
*/
const std::vector<std::string> steam_boiler_sensors = {
    "Temperature", "Pressure"
};

/**
 * @brief Sensor set fro Electric Motor
 * 
 * Electric motors are monitored for: Temperature
*/
const std::vector<std::string> electric_motor_sensors = {
    "Temperature"
};

// --------------------------------------------------------------------------
//  C API implementation
// --------------------------------------------------------------------------

/**
 * @brief Create a machine instance with sensors based on machine type.
 * 
 * This function dynamically allocates a C++ Machine object and returns 
 * it as an opaque handles usable from C code.
 * 
 * Sensor composition is determined at runtime based on the provided 
 * machine type
 * 
 * @param machine_name Human-readable machine name
 * @param type         Machine type enum
 * 
 * @return Opaque handle to the created machine
*/
MachineHandle create_machine(const char* machine_name, MachineType type) 
{
    std::vector<std::string> sensors;
    
    // Select sensor configuration based on machine type
    switch(type) {
        case AIR_COMPRESSOR:
            sensors = air_compressor_sensors;
            break;
        case STEAM_BOILER:
            sensors = steam_boiler_sensors;
            break;
        case ELECTRIC_MOTOR:
            sensors = electric_motor_sensors;
            break;
    }
    
    // Allocate C++ Machine object
    Machine* machine = new Machine(std::string(machine_name), sensors, type);

    // Return as opaque C handle
    return reinterpret_cast<MachineHandle>(machine);
}

/**
 * @brief Destroy a machine instance and free its resources.
 * 
 * @param handle Opaque nachine handle
*/
void destroy_machine(MachineHandle handle) 
{
    Machine* machine = reinterpret_cast<Machine*>(handle);
    delete machine;
}

/**
 * @brief Print a textual description of the machine and its sensors
 * 
 * @param handle Opaque machine handle
*/
void describe_machine(MachineHandle handle) 
{
    Machine* machine = reinterpret_cast<Machine*>(handle);
    machine->display();
}

/**
 * @brief Set a sensor value on a machine.
 * 
 * @param handle      Opaque machine handle
 * @param sensor_type Sensor type string (e.g. "Temperature")
 * @param value       New sensor reading
*/
void set_sensor_value(MachineHandle handle, const char* sensor_type, float value) 
{
    Machine* machine = reinterpret_cast<Machine*>(handle);
    machine->setSensorValue(sensor_type, value);
}

/**
 * @brief Retrieve a sensor value from a machine.
 *
 * @param handle      Opaque machine handle
 * @param sensor_type Sensor type string
 * @return            Sensor reading, or negative value if not found
*/
float get_sensor_value(MachineHandle handle, const char* sensor_type) 
{
    Machine* machine = reinterpret_cast<Machine*>(handle);
    return machine->getSensorValue(sensor_type);
}

/**
 * @brief Convert a machine type enum to a human-readable string.
 *
 * @param type Machine type enum
 * @return String representation of the machine type
*/
const char* get_machine_type_string(MachineType type) 
{
    switch (type) {
        case AIR_COMPRESSOR: return "Air Compressor";
        case STEAM_BOILER: return "Steam Boiler";
        case ELECTRIC_MOTOR: return "Electric Motor";
        default: return "Unknown Type";
    }
}

/**
 * @brief Get the machine type of a given machine instance.
 *
 * @param handle Opaque machine handle
 * @return MachineType enum
*/
MachineType get_machine_type(MachineHandle handle) {
    Machine* machine = reinterpret_cast<Machine*>(handle);
    return machine->getType();
}
```

## src/threads.c
```c
/**
 * @file threads.c
 * @brief
 * 
 * Description
*/

#include <stdlib.h>
#include <zephyr/kernel.h>

#include "threads.h"
#include "machines.h"

/**
 * @brief Message queue for passing log messages from threads 1-4 to system_logger
 * 
 * Holds up to @ref LOG_QUEUE_SIZE messages of type @ref log_msg_t.
 * Defined here and declared extern in threads.h.
*/
K_MSGQ_DEFINE(log_queue, sizeof(log_msg_t), LOG_QUEUE_SIZE, MESSAGE_ALIGN);

/**
 * @brief Thread 1: Write simulated sensor values into sensor objects
 * 
 * 
*/
void sensor_data_writer(void) 
{
    while (1) {
        log_msg_t msg = {.thread_id = 1, .message = "Set machines values:"};
        k_msgq_put(&log_queue, &msg, K_NO_WAIT);

        // Iterate through each machine and set all sensor values in that machine
        for (int i=0; i<NUM_MACHINES; i++) 
        {
            MachineType type = get_machine_type(machines[i]);
            if (type < 0 || type >= (sizeof(machine_configs) / sizeof(machine_configs[0]))) {
                printf("Error: Invalid machine type %d\n", type); -> how can we handle this better? 
                continue;
            }
        }

        // Use MachineType to index into machine_configs 
        const MachineConfig* config = &machine_configs[type];

        printf("%s:", config->name);
        for (int s=0; s < config->num_sensors; s++) {
            const SensorConfig* sensor = &config->sensors[s];
            
            if (strlen(sensor->name) == 0) continue;                    // Skip invalid sensors

            float range = sensor->max_value - sensor->min_value;
            float value = sensor->min_value + (rand() / (float)RAND_MAX) * range;

            set_sensor_value(machines[i], sensor->name, value);
            if (s == 0) {
                printf(" %s = %.2f  [range %.1f-%.1f]\n",  
                    sensor->name, (double)value, (double)sensor->min_value, (double)sensor->max_value);
            } else {
                printf("                %s = %.2f  [range %.1f-%.1f]\n",  
                    sensor->name, (double)value, (double)sensor->min_value, (double)sensor->max_value);
            }
        }
        k_msleep(2000);
    }
}

/**
 * @brief Thread 2: Read sensor values and write into the circular buffer
 * 
 * 
*/
void data_collector(void)
{
    while (1) {
        log_msg_t msg = {.thread_id = 2, .message = "In thread 2"};
        k_msgq_put(&log_queue, &msg, K_NO_WAIT);
        k_msleep(500);
    }
}

/**
 * @brief Thread 3: Consume data from the circular buffer and perform anomaly detection
 * 
 * 
*/
void anomaly_detector(void)
{
    while (1) {
        log_msg_t msg = {.thread_id = 3, .message = "In thread 3"};
        k_msgq_put(&log_queue, &msg, K_NO_WAIT);
        k_msleep(500);
    }
}

/**
 * @brief Thread 4: Handle detected anomalies (event-driven -> triggered by anomaly_detector)
 * 
 * 
 * 
*/
void anomaly_handler(void) 
{
    while (1) {
        log_msg_t msg = {.thread_id = 4, .message = "In thread 4"};
        k_msgq_put(&log_queue, &msg, K_NO_WAIT);
        k_msleep(500);
    }
}

/**
 * @brief Thread 5: Consume log messages from the logging queue and print to terminal
 * 
 * 
 * 
*/
void system_logger(void) 
{
    log_msg_t msg;

    while (1) {
        k_msgq_get(&log_queue, &msg, K_FOREVER);
        printk("Thread %d: %s\n", msg.thread_id, msg.message);
    }
}
```
